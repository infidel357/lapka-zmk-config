## config/west.yml
```yaml
manifest:
  defaults:
    revision: v0.3
  remotes:
    - name: zmkfirmware
      url-base: https://github.com/zmkfirmware
    # Добавляем remote для Prospector
    - name: prospector
      url-base: https://github.com/t-ogura
  projects:
    - name: zmk
      remote: zmkfirmware
      import: app/west.yml
    # Добавляем сам модуль Prospector
    - name: prospector-zmk-module
      remote: prospector
      revision: v2.2.0
      path: modules/prospector-zmk-module
  self:
    path: config
```
